#include <stdio.h>
#include "NuMicro.h"

/*---------------------------------------------------------------------------------------------------------*/
/* Global variables                                                                                        */
/*---------------------------------------------------------------------------------------------------------*/
#define OLED_ADDR 0x3c

uint8_t LCD_comm[]= {
   0xAE,             //Display Off
   0xD5,0x80,
   
   0xA8,0x3F,        //Set Multiplex Ratio     1F - 128x32, 3F - 128x64
   
   0xD3,0x00,        //Set Display Offset
   0x40,
   
   0x8D,0x14,        // Charge Pump set:   0x10 = VCC Supplied Externally  
                      // 0x14 = VCC Generated by Internal
   
   0x20,0x00,        //Set Memory Addressing Mode 
   
   0xA0,             //Set Segment Re-map  A0/A1
   0xC0,             //Vertical flip    C0/C8
   
   0xDA,0x10,        //Set COM Pins Hardware Configuration //02 - 128x32, 10 - 128x64
   
   0x81,0xA2,        //Set Contrast Control 
   
   0xD9,0xF1,        //Set Pre-Charge Period:  0x22 = VCC Supplied Externally  \
   //0xF1 = VCC Generated by Internal             
   
   0xDB,0x40,        //Set VCOMH Deselect Level
   
   0xA4,             //Set Entire Display On/Off
   0xA6,             //Set NORMAL/INVERT Display   A6/A7
   
   0xAF,             //Display On
   
   0xFF
};
const uint8_t font [][5] =      //5x8 size, but have 1 pixel for spave , so is 6x8
{
   { 0x00, 0x00, 0x00, 0x00, 0x00 },   //   0x20  32
   { 0x00, 0x00, 0x5F, 0x00, 0x00 },   // ! 0x21  33
   { 0x00, 0x07, 0x00, 0x07, 0x00 },   // " 0x22  34
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   { 0x06, 0x09, 0x09, 0x06, 0x00 },   // heart 0x7F 127    
};

uint8_t LCD_picture[]= {
#if 0
//Marilyn-Monroe-2
0xff, 0xff, 0xff, 0xff, 0xff, 0xff, 0xff, 0xff, 0xff, 0xff, 0xff, 0xff, 0xff, 0xff, 0xff, 0xff, 
0xff, 0xff, 0xff, 0xff, 0xff, 0xff, 0xff, 0xff, 0xff, 0xff, 0xff, 0xff, 0xff, 0xff, 0xff, 0xff, 
0xff, 0xff, 0xff, 0xff, 0xff, 0xff, 0xff, 0xff, 0xff, 0xcf, 0xef, 0xff, 0xfe, 0xfe, 0xfc, 0xfc, 
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0xff, 0xff, 0xff, 0xff, 0xff, 0xff, 0xff, 0xff, 0xff, 0xff, 0xff, 0xff, 0xff, 0xff, 0xff, 0xff
#else
//coffee
0xff, 0xff, 0xff, 0xff, 0xff, 0xff, 0xff, 0xff, 0xff, 0xff, 0xff, 0xff, 0xff, 0xff, 0xff, 0xff, 
0xff, 0xff, 0xff, 0xff, 0xff, 0xff, 0xff, 0xff, 0xff, 0xff, 0xff, 0xff, 0xff, 0xff, 0xff, 0xff, 
0xff, 0xff, 0xff, 0xff, 0xff, 0xff, 0xff, 0xff, 0xff, 0xff, 0xff, 0xff, 0xff, 0xff, 0xc3, 0x81, 
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0xff, 0xff, 0xff, 0xff, 0xff, 0xff, 0xff, 0xff, 0xff, 0xff, 0xff, 0xff, 0xff, 0xff, 0xff, 0xff
#endif
};

#define DATA_MODE       0x40
#define COMMAND_MODE    0x00   // bit Co = 0, D/C# = 0
#define BUFF_SIZE       1025    //513

#define column_start    0
#define column_end      127
#define page_start      0
#define page_end        7       //3

uint8_t  lcd_buff[BUFF_SIZE];
uint16_t lcd_buff_idx=0;
uint8_t  x_cur=0;
uint8_t  y_cur=0;
//----------------------------------------------------------------------------------
void LCD_Init(void)
{
    int r_code;
    I2C0_WriteMultiByteOneReg(OLED_ADDR, COMMAND_MODE, LCD_comm, sizeof(LCD_comm));	
}
//----------------------------------------------------------------------------------
void  LCD_command(uint8_t cmd)
{ 
    int r_code;
    uint8_t cmd_arr[2] = {0,0};
    cmd_arr[0] = COMMAND_MODE;
    cmd_arr[1] = cmd;

	  uint8_t data[10] = {0};
		data[0]=cmd;
		
    I2C0_WriteMultiByteOneReg(OLED_ADDR, COMMAND_MODE, data, 1);
}
//----------------------------------------------------------------------------------
void LCD_On(void)
{
   LCD_command(0xAF);
}
//----------------------------------------------------------------------------------
void LCD_Off(void)
{
   LCD_command(0xAE);
}
//----------------------------------------------------------------------------------
void LCD_Clear(void)
{
	uint16_t ix=0;
   for(ix = 1; ix < BUFF_SIZE; ix++)
   {
      lcd_buff[ix] = 0;
   }
   x_cur = 0;
   y_cur = 0;
}
//----------------------------------------------------------------------------------
void LCD_Update(void)
{
   int r_code;
  
   LCD_command(0x21);             // SSD1306_COLUMNADDR
   LCD_command(column_start);     // column start
   LCD_command(column_end);       // column end
   LCD_command(0x22);             // SSD1306_PAGEADDR
   LCD_command(page_start);       // page start
   LCD_command(page_end);         // page end (4 pages for 32 rows OLED)
   
   lcd_buff[0]= DATA_MODE;              
   
   I2C0_WriteMultiByteOneReg(OLED_ADDR, DATA_MODE, lcd_buff, sizeof(lcd_buff));
}
//----------------------------------------------------------------------------------
void LCD_Chr(uint8_t ch)
{
   uint8_t i;   
   lcd_buff_idx=(y_cur*128 + x_cur*6) + 1;    
   if ((ch >= 0x20)&&(ch <= 0x7F)) ch -= 32;
   else ch = 95;   
   for (i = 0; i < 5; i++)
   {
        lcd_buff[lcd_buff_idx++] = font[ch][i];       
   }
   lcd_buff[lcd_buff_idx++] = 0x00;  
   x_cur++;
   if (x_cur > 20)
   {
      x_cur = 0;
      y_cur++;
      if (y_cur > 7)    //3
      {
         y_cur = 0;
      }
   }
}
////----------------------------------------------------
void LCD_GotoXY(uint8_t x,uint8_t y)
{
   if((x < 21)&&(y < (page_end+1)))
   {
      x_cur = x;
      y_cur = y;
   }
}
//----------------------------------------------------------------------------------
void LCD_FStr(const char *dataPtr, uint8_t x, uint8_t y)
{
   LCD_GotoXY(x,y);
   while(*dataPtr != 0)
   {
      LCD_Chr(*dataPtr);
      dataPtr++;
   }
}
////----------------------------------------------------
////  This function adds a battery symbol to the lcd buffer
////----------------------------------------------------
void LCD_Batt(int val, uint8_t x, uint8_t y)
{   
   uint8_t bat_arr[] = { 0x1C, 0x1C, 0x7F, 0x41, 0x41, 0x41, 0x41, 0x41, 0x41, 0x41, 0x41, 0x41, 0x41, 0x41, 0x41, 0x7F };

   uint8_t cnt_val = sizeof(bat_arr) - 3;

   while(val > 0)
   {      
      bat_arr[cnt_val--]= 0x5D; //0x7F is fill full
      val -= 10;  // array
   }
   lcd_buff_idx = (y*128 + x + 1);
	 uint8_t i=0;
   for(i = 0; i<sizeof(bat_arr); i++)
   {
      lcd_buff[lcd_buff_idx++]=bat_arr[i];
   }

}
//----------------------------------------------------------------------------------
void LCD_show()
{
	uint16_t i=0;
	lcd_buff_idx=1;
   for(i = 0; i<sizeof(LCD_picture); i++)
   {
      lcd_buff[lcd_buff_idx++]=LCD_picture[i];
   }
}
//----------------------------------------------------------------------------------
void GW_OLED_Init(void)
{
		//LCD_Init();

		LCD_Clear();
		LCD_On();
		#if 0
			LCD_FStr("Good Way Inc.", 0, 0);
			LCD_FStr("DUD8070R1", 0, 1);
			LCD_FStr("ABCD12345678", 0, 4);				
			LCD_Batt(50, 0, 7);
		#else
			LCD_show();
		#endif
		LCD_Update();				

    /* Close I2C0 */
    I2C0_Close();
}